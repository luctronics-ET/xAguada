## firmware/sen_aguada_v1/sdkconfig.defaults
```kconfig
# ESP32-C3 Configuration for sen_aguada_v1
CONFIG_IDF_TARGET="esp32c3"
CONFIG_ESP_CONSOLE_UART_BAUDRATE=115200
CONFIG_FREERTOS_HZ=1000
CONFIG_ESP_TASK_WDT=y
CONFIG_ESP_TASK_WDT_TIMEOUT_S=120
CONFIG_PARTITION_TABLE_SINGLE_APP=y
```
